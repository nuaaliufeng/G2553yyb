#include <msp430.h>
#define uchar unsigned char 
#define uint unsigned int

uint pic= 0;      //切换画面变量
uint dir = 0;     //方向变量

uchar a[]={
0x00,0x00,0x00,0x00,0x00,0x00,0x00,0x00,
0x00,0x00,0x00,0x00,0x00,0x00,0x00,0x00,
0x78,0xFC,0xFE,0xFE,0xFE,0xFE,0xFE,0xFC,
0xF8,0xFC,0xFE,0xFE,0xFE,0xFE,0xFE,0xFC,
0x78,0x00,0x00,0x00,0x00,0x00,0x00,0x00,
0x00,0x00,0x00,0x00,0x00,0x00,0x00,0x00,
0x00,0x00,0x00,0x00,0x00,0x00,0x00,0x00,
};
uchar b[]={
  0x00,0x00,0x00,0x00,0x00,0x00,0x00,0x00,
  0x00,0x00,0x00,0x00,0x00,0x00,0x00,0x00,
  0x00,0x00,0x01,0x03,0x07,0x0F,0x1F,0x3F,
  0x7F,0x3F,0x1F,0x0F,0x07,0x03,0x01,0x00,
  0x00,0x00,0x00,0x00,0x00,0x00,0x00,0x00,
  0x00,0x00,0x00,0x00,0x00,0x00,0x00,0x00,
  0x00,0x00,0x00,0x00,0x00,0x00,0x00,0x00
};                                         //心形图片

uchar love[]={
0x00,0x00,0x00,0x00,0x00,0x00,0x00,0x00,0x00,0x00,0x00,0x00,0x00,0x00,0x00,0x00,
0x00,0x00,0x00,0x00,0x00,0x00,0x00,0x00,0xFE,0x3F,0x00,0x20,0x00,0x20,0x00,0x20,
0x00,0x20,0x00,0x20,0x00,0x20,0x00,0x20,0x00,0x00,0x00,0x00,0x00,0x00,0xF8,0x0F,
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0x00,0x00,0x00,0x00,0x00,0x00,0x00,0x00,0x00,0x00,0x00,0x00,0x00,0x00,0x00,0x00   /*LOVE*/
};

uchar nanhang[]={
  0x04,0x00,0xE4,0xFF,0x24,0x00,0x24,0x08,0x64,0x09,0xA4,0x09,0x24,0x09,0x3F,0x7F,
  0x24,0x09,0xA4,0x09,0x64,0x09,0x24,0x48,0x24,0x80,0xE4,0x7F,0x04,0x00,0x00,0x00,
  0x80,0x80,0xFC,0x7F,0x96,0x02,0xE5,0x4C,0x84,0x80,0xFC,0x7F,0x00,0x80,0x08,0x60,
  0xC8,0x1F,0x49,0x00,0x4A,0x00,0xC8,0x3F,0x08,0x40,0x08,0x40,0x00,0x78,0x00,0x00     //南航文字
};
//*********************延时函数************************************************//
void delay(uint t)
{ uchar i=100;
  while(i--)
  {t--;}
}
//**********************初始化程序*******************************************//
void Init()
{                                           //打开总中断
  WDTCTL = WDTPW + WDTHOLD;                 // 关闭看门狗
  P1DIR |= BIT4 + BIT5;                     // P1.4 P1.5 设为输出
  P1OUT |= BIT4 + BIT5;                     // P1.4 P1.5输出1，三极管导通，打开LED开关
  P2SEL = 0;                                //选择IO功能    
  P2DIR = 0xff;                             //P2输出    
  P2OUT = 0xff;                             //输出高电压LED全灭 
  P1DIR &= ~0x88;                           //P1.3，1.7为输入                                                        
  P1REN |= 0x88;                             //设置上拉电阻 */
  P1OUT|=BIT3;                               //上拉电阻设置
  P1IE |=0x88;                              //打开P1.7中断使能
  P1IES &= ~(BIT7);                           //P1.7触发方式为上升沿触发
  P1IES &=~BIT3;                             //P1.3触发方式为上升沿，也可以改为下降沿
  P1IFG = 0x00;                             //清除P1端口中断信号 
}

//**************************扫描显示程序**************************************//
void display_xin()          //显示心形
{
  uint i;
  P1DIR |= BIT4 +BIT5;     //打开显示，P1.4，P1.5均为输出状态
  P2OUT = 0xff;            //P2端口输出低电平，数码管全灭
  for(i=0;i<=55;i++)
  { P1DIR |=BIT4;           
    P1DIR &=~BIT5;        //P1.4高电平，P1.5低电平D0~D7显示
    P2OUT = ~a[i];
    delay(500);           
    P1DIR |=BIT5;
    P1DIR &=~BIT4;         //P1.5高电平，P1.4低电平，D8~Df显示
    P2OUT = ~b[i];
    delay(500);
  }
  P1DIR |= BIT4 +BIT5;
  P2OUT = 0xff;            //数码管全灭            
}
void display_love()     //显示LOVE
{
  uint i;
  P1DIR |= BIT4 +BIT5;
  P2OUT = 0xff;      
  for(i=0;i<=63;i++)
  { P1DIR |=BIT4;
    P1DIR &=~BIT5;
    P2OUT=~love[i*2];
    delay(500);
    P1DIR |=BIT5;
    P1DIR &=~BIT4;
    P2OUT=~love[i*2+1];
    delay(500);
  }
}
void display_nanhang()      //显示南航
{
  uint i;
  P1DIR |= BIT4 +BIT5;
  P2OUT = 0xff;      
  for(i=0;i<=31;i++)
  {P1DIR |=BIT4;
    P1DIR &=~BIT5;
    P2OUT=~nanhang[i*2];
    delay(500);
    P1DIR |=BIT5;
    P1DIR &=~BIT4;
    P2OUT=~nanhang[i*2+1];
    delay(500);
  }
  P1DIR |= BIT4 +BIT5;
  P2OUT = 0xff;     
}

//**************************主程序*******************************************//
void main(void)
{
  Init();                                  //初始化程序     
  _EINT();                                 //打开总中断
  while(1);                             //死循环
}

//**********************中断程序*******************************************//
#pragma vector=PORT1_VECTOR
__interrupt void Port_1(void)
{ 
  //****判断中断为P1.3按键中断，每次中断改变显示画面变量pic***************//
 if(P1IFG&BIT3)                    
  { for(int a=0;a<100;a++) 
    delay(1000); 
    if(P1IN & BIT3)  
    {
      if(pic<3)
      {
        pic++;
        P1IFG &=~ BIT3;
      }
      else if(pic==2)
      {   
        pic=0;
        P1IFG &=~ BIT3;
      }
    }
  }
 //**中断为P1.7中断，每次方向变量取反，只有一次显示进行去重影***********//  
  else if((P1IFG&BIT7)==BIT7)
  {
    delay(500); 
    P1IFG &= ~BIT7;                                   //清除中断标志
    dir=!dir;                                       //方向反向       
    if(dir==0)
    {
      switch(pic)
      {
        case 0:{display_xin();}break;
        case 1:{display_love();}break;
        case 2:{display_nanhang();}break;
      }
    }            
  }
};
